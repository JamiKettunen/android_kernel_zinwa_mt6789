## drivers/misc/mediatek/rt-regmap/Kconfig
```kconfig
config RT_REGMAP
	tristate "Richtek regmap"
	help
	  Say Y to enable Richtek regmap
	  Interface for register debug node and ops.
	  This config decide to use regmap easy
	  for debug in RT chip.
```
