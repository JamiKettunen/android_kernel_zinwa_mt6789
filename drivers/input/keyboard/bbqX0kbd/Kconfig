## drivers/input/keyboard/bbqX0kbd/Kconfig
```kconfig
# SPDX-License-Identifier: GPL-2.0-only
#
# Input core configuration
#
config KEYBOARD_BBQX0_KEYBOARD
	tristate "BBQX0 Keypad Support"
	depends on OF && HAVE_CLK
	help
	  Say Y here if you want to use the keypad on MediaTek SoCs.
	  If unsure, say N.
	  To compile this driver as a module, choose M here: the
	  module will be called BBQX0 KEYBAORD.
```
